## rns-esp32/sdkconfig.defaults
```kconfig
# Rust needs a larger main task stack
CONFIG_ESP_MAIN_TASK_STACK_SIZE=16384

# Custom partition table with larger app partition (4MB - 64KB)
CONFIG_PARTITION_TABLE_CUSTOM=y
CONFIG_PARTITION_TABLE_CUSTOM_FILENAME="../../../../../../partitions.csv"

# Enable SPI
CONFIG_SPI_MASTER_IN_IRAM=y

# NVS for identity persistence
CONFIG_NVS_ENCRYPTION=n

# Disable console on UART0 so it is clean for KISS protocol.
# ESP-IDF defaults to outputting logs on UART0, which corrupts RNode framing.
CONFIG_ESP_CONSOLE_NONE=y

# Logging
CONFIG_LOG_DEFAULT_LEVEL_INFO=y
CONFIG_LOG_MAXIMUM_LEVEL_DEBUG=y

# Flash size (Heltec V3 has 8MB)
CONFIG_ESPTOOLPY_FLASHSIZE_8MB=y

# Disable task watchdog — crypto operations are slow
CONFIG_ESP_TASK_WDT=n

# BLE via NimBLE — peripheral role only (NUS GATT server for BLE serial bridge)
CONFIG_BT_ENABLED=y
CONFIG_BT_NIMBLE_ENABLED=y
CONFIG_BT_CONTROLLER_ENABLED=y
CONFIG_BT_NIMBLE_MAX_CONNECTIONS=1
CONFIG_BT_NIMBLE_ROLE_CENTRAL=n
CONFIG_BT_NIMBLE_ROLE_OBSERVER=n
CONFIG_BT_NIMBLE_ROLE_BROADCASTER=y
CONFIG_BT_NIMBLE_ROLE_PERIPHERAL=y
CONFIG_BTDM_CTRL_MODE_BLE_ONLY=y
CONFIG_BT_NIMBLE_NVS_PERSIST=y
```
